## CMakeLists.txt
```
#
# Copyright (c) 2024 Nordic Semiconductor
#
# SPDX-License-Identifier: LicenseRef-Nordic-5-Clause
#

cmake_minimum_required(VERSION 3.20.0)
find_package(Zephyr REQUIRED HINTS $ENV{ZEPHYR_BASE})
project(iso_time_sync)

target_include_directories(app PRIVATE include)
target_sources(app PRIVATE src/main.c src/timed_led_toggle.c src/time_sync.c src/sync_log.c)

if(CONFIG_TIME_SYNC_TEMP_COMP)
  target_sources(app PRIVATE src/temp_sensor.c)
endif()

if(CONFIG_BT_ISO_BROADCASTER)
  target_sources(app PRIVATE src/bis_transmitter.c)
endif()

if(CONFIG_BT_ISO_SYNC_RECEIVER)
  target_sources(app PRIVATE src/bis_receiver.c)
endif()

if(CONFIG_BT_ISO_CENTRAL)
  target_sources(app PRIVATE src/cis_central.c)
endif()

if(CONFIG_BT_ISO_PERIPHERAL)
  target_sources(app PRIVATE src/cis_peripheral.c)
endif()

if(CONFIG_BT_ISO_TX_BUF_COUNT)
  target_sources(app PRIVATE src/iso_tx.c)
endif()

if(CONFIG_BT_ISO_RX_BUF_COUNT)
  target_sources(app PRIVATE src/iso_rx.c)
endif()

if(CONFIG_SOC_COMPATIBLE_NRF52X)
  target_sources(app PRIVATE src/controller_time_nrf52.c)
elseif(CONFIG_SOC_COMPATIBLE_NRF5340_CPUAPP)
  target_sources(app PRIVATE src/controller_time_nrf53_app.c)
elseif(CONFIG_SOC_SERIES_NRF54L OR CONFIG_SOC_SERIES_NRF54H)
  target_sources(app PRIVATE src/controller_time_nrf54.c)
else()
  message(FATAL_ERROR "Unsupported series")
endif()
```

## Kconfig
```
#
# Copyright (c) 2024 Nordic Semiconductor
#
# SPDX-License-Identifier: LicenseRef-Nordic-5-Clause
#

menu "Bluetooth ISO time sync sample"

config SDU_INTERVAL_US
	int "SDU interval to be used in microseconds"
	default 10000
	help
	  The SDU interval determines how often the button
	  value will be transmitted to the receiving devices.

config TIMED_LED_PRESENTATION_DELAY_US
	int "The delay of presenting the new value of the LED"
	default 5000
	help
	  The presentation delay of the LED represents the time
	  from the SDU synchronization reference until the value
	  is applied.
	  The application needs to ensure it can process the
	  received SDU within this amount of time.
	  The end-to-end latency will be at least the sum
	  of the configured transport latency and presentation delay

config LED_TOGGLE_IMMEDIATELY_ON_SEND_OR_RECEIVE
	bool "Enable immediate LED toggling upon sending or receiving data"
	help
	  Enable immediate toggling of LED2 when isochronous
	  data is sent or received. This allows for measurment
	  of the mimimum end-to-end latency.

config TIME_SYNC_LT_STATS_PERIOD_S
	int "Long-term stability summary period in seconds"
	default 60
	range 1 86400
	help
	  How often each receiver prints a long-term stability summary line
	  (offset min/max/span, drift, worst residual, packet loss). Intended
	  for long-run (>= 1 hour) verification of the shared timestamp.

config TIME_SYNC_TEMP_COMP
	bool "Temperature-adaptive servo process noise"
	default y
	depends on DT_HAS_NORDIC_NRF_TEMP_ENABLED
	help
	  Sample the on-chip temperature sensor and scale the Kalman filter's
	  process noise with the temperature rate of change. The servo stays
	  quiet when the crystal is thermally stable and tracks faster when the
	  temperature is moving, which improves long-term stability.

config TIME_SYNC_TEMP_PERIOD_MS
	int "Temperature sampling period in milliseconds"
	default 1000
	range 100 60000
	depends on TIME_SYNC_TEMP_COMP
	help
	  How often the on-chip temperature is sampled and fed to the servo.

config BIS_TIME_SYNC_MEASURE_GPIO
	bool "Expose controller-timed BIS presentation on GPIO"
	default n
	help
	  Always schedule a fresh controller-timed presentation event, even
	  when consecutive SDUs carry the same value. This makes the timing
	  measurement independent of payload changes. Capture led1 on every
	  node with a logic analyzer or oscilloscope.

endmenu

source "Kconfig.zephyr"
```

## prj.conf
```kconfig
CONFIG_NCS_SAMPLES_DEFAULTS=y

CONFIG_BT=y
CONFIG_BT_ISO_BROADCASTER=y
CONFIG_BT_ISO_SYNC_RECEIVER=y
CONFIG_BT_ISO_CENTRAL=y
CONFIG_BT_ISO_PERIPHERAL=y
CONFIG_BT_OBSERVER=y
CONFIG_BT_CENTRAL=y
CONFIG_BT_PERIPHERAL=y

# Low Power Mode: controller drops to sleep between ISO events instead of
# staying in active mode. Expected to cut RX average current by ~1–2 mA.
CONFIG_BT_CTLR_SDC_LLPM=y
CONFIG_BT_DEVICE_NAME="Nordic_ISO"

CONFIG_BT_MAX_CONN=5

# One BIS per receiver: broadcaster + seven independent receiver nodes.
CONFIG_BT_ISO_MAX_CHAN=8
CONFIG_BT_ISO_TX_BUF_COUNT=8
CONFIG_BT_CTLR_SDC_ISO_TX_HCI_BUFFER_COUNT=8
CONFIG_BT_CTLR_ADV_ISO_STREAM_COUNT=8
CONFIG_BT_CTLR_SYNC_ISO_STREAM_COUNT=8
CONFIG_BT_CTLR_SDC_PERIPHERAL_COUNT=1


CONFIG_BT_CTLR_CONN_ISO_STREAMS=4

# Host TX buffer capacity; must be >= SDU_SIZE_BYTES (9). 16 leaves headroom.
CONFIG_BT_ISO_TX_MTU=16

# Controller-timestamped presentation; keep host processing well before the deadline.
# Note: the presentation delay must also satisfy ts_offset + delay < SDU interval.
# The sync receiver processes an SDU ~3 ms before its timestamp, so the trigger
# must be armed less than one interval ahead or it gets overwritten by the next
# SDU before it ever fires. With the minimum ISO interval (5 ms) the upper bound
# is ~2000 us, so PD=1500 us leaves ~0.5 ms margin. Do NOT raise PD further:
# the next SDU re-arms the GRTC compare 5 ms after this one, and a larger PD
# would be overwritten before it fires. The margin is instead protected by
# keeping the RX/TX callbacks short (logging is deferred to a low-priority
# thread, see src/sync_log.c).
CONFIG_SDU_INTERVAL_US=5000
CONFIG_TIMED_LED_PRESENTATION_DELAY_US=1500
# Disable host GPIO toggles during precision captures.
# CONFIG_LED_TOGGLE_IMMEDIATELY_ON_SEND_OR_RECEIVE is not set
CONFIG_BT_ISO_RX_MTU=23

CONFIG_NRFX_GPPI=y

# On-chip TEMP for the temperature-adaptive servo process noise. The temp
# node is enabled in boards/nrf54l15dk_nrf54l15_cpuapp.overlay; with it,
# CONFIG_TEMP_NRF5 and CONFIG_TIME_SYNC_TEMP_COMP default to y.
CONFIG_SENSOR=y

CONFIG_CONSOLE=y
CONFIG_CONSOLE_SUBSYS=y
CONFIG_CONSOLE_HANDLER=y
CONFIG_CONSOLE_GETCHAR=y
```

## boards/nrf54l15dk_nrf54l15_cpuapp.overlay
```dts
/*
 * Enable the on-chip temperature sensor. It feeds the temperature-adaptive
 * Kalman process noise (CONFIG_TIME_SYNC_TEMP_COMP).
 */

&temp {
	status = "okay";
};
```

## src/main.c
```c
/*
 * Copyright (c) 2024 Nordic Semiconductor ASA
 *
 * SPDX-License-Identifier: LicenseRef-Nordic-5-Clause
 */

#include <zephyr/kernel.h>
#include <zephyr/drivers/gpio.h>
#include <zephyr/bluetooth/bluetooth.h>
#include "iso_time_sync.h"

#define BIS_NODE_COUNT 8U

/* Default BIS parameters used when the role is selected by GPIO instead of
 * the serial console.
 */
#define BIS_TX_RTN                       1
#define BIS_TX_MAX_TRANSPORT_LATENCY_MS  10
#define BIS_RX_DEFAULT_INDEX             1

/* Role selection is done by sampling P1.09 (Button 1 on the nRF54L15DK,
 * devicetree alias sw1) once at boot:
 *   - low level (button held / pin tied to GND) -> BIS transmitter
 *   - otherwise (pull-up keeps it high)         -> BIS receiver
 */
#define ROLE_PIN_SETTLE_TIME_MS 50
#define ROLE_PIN_SAMPLE_COUNT   5

static const struct gpio_dt_spec role_pin = GPIO_DT_SPEC_GET(DT_ALIAS(sw1), gpios);

/* Button (sw0 = P1.13) that requests an immediate time-sync event on the
 * transmitter. Debounced in software.
 */
#define SYNC_BTN_DEBOUNCE_MS 50
static const struct gpio_dt_spec sync_btn = GPIO_DT_SPEC_GET(DT_ALIAS(sw0), gpios);
static struct gpio_callback sync_btn_cb;
static int64_t last_sync_req_ms;

/** Sample the role pin and return true if the device shall act as BIS transmitter. */
static bool role_pin_selects_transmitter(void)
{
	int err;
	int low_count = 0;

	if (!gpio_is_ready_dt(&role_pin)) {
		printk("Role pin device not ready, defaulting to BIS receiver\n");
		return false;
	}

	err = gpio_pin_configure_dt(&role_pin, GPIO_INPUT);
	if (err != 0) {
		printk("Error %d: failed to configure role pin, defaulting to BIS receiver\n",
		       err);
		return false;
	}

	/* Let the pull-up settle, then sample the pin a few times to avoid
	 * deciding on a glitch.
	 */
	k_msleep(ROLE_PIN_SETTLE_TIME_MS);

	for (int i = 0; i < ROLE_PIN_SAMPLE_COUNT; i++) {
		int val = gpio_pin_get_dt(&role_pin);

		if (val < 0) {
			printk("Error %d: failed to read role pin, defaulting to BIS receiver\n",
			       val);
			return false;
		}

		/* The pin is GPIO_ACTIVE_LOW, so a logical 1 means the physical
		 * level is low.
		 */
		if (val > 0) {
			low_count++;
		}

		k_msleep(2);
	}

	return low_count > (ROLE_PIN_SAMPLE_COUNT / 2);
}

static void sync_btn_pressed(const struct device *dev, struct gpio_callback *cb,
			     uint32_t pins)
{
	int64_t now = k_uptime_get();

	(void)dev;
	(void)cb;
	(void)pins;

	if ((now - last_sync_req_ms) < SYNC_BTN_DEBOUNCE_MS) {
		return;
	}
	last_sync_req_ms = now;

	iso_tx_request_sync();
}

static void sync_button_init(void)
{
	int err;

	if (!gpio_is_ready_dt(&sync_btn)) {
		printk("Sync button device not ready\n");
		return;
	}

	err = gpio_pin_configure_dt(&sync_btn, GPIO_INPUT);
	if (err != 0) {
		printk("Error %d: failed to configure sync button\n", err);
		return;
	}

	err = gpio_pin_interrupt_configure_dt(&sync_btn, GPIO_INT_EDGE_TO_ACTIVE);
	if (err != 0) {
		printk("Error %d: failed to configure sync button interrupt\n", err);
		return;
	}

	gpio_init_callback(&sync_btn_cb, sync_btn_pressed, BIT(sync_btn.pin));
	gpio_add_callback(sync_btn.port, &sync_btn_cb);

	printk("Sync button ready (sw0 = P1.13)\n");
}

int main(void)
{
	int err;
	bool transmitter;

	printk("Bluetooth ISO Time Sync Demo\n");

	transmitter = role_pin_selects_transmitter();
	printk("Role pin P1.09 %s -> %s role\n",
	       transmitter ? "low" : "not low",
	       transmitter ? "BIS transmitter" : "BIS receiver");

	err = timed_led_toggle_init();
	if (err != 0) {
		printk("Error failed to init LED device for toggling\n");
		return err;
	}

	/* Initialize the Bluetooth Subsystem */
	err = bt_enable(NULL);
	if (err) {
		printk("Bluetooth init failed (err %d)\n", err);
		return 0;
	}

	if (transmitter) {
		printk("Starting BIS transmitter with %u BIS streams, RTN: %d, max transport "
		       "latency %d ms\n",
		       BIS_NODE_COUNT, BIS_TX_RTN, BIS_TX_MAX_TRANSPORT_LATENCY_MS);
		sync_button_init();
		bis_transmitter_start(BIS_TX_RTN, BIS_TX_MAX_TRANSPORT_LATENCY_MS);
	} else {
		printk("Starting BIS receiver, BIS index %d\n", BIS_RX_DEFAULT_INDEX);
		bis_receiver_start(BIS_RX_DEFAULT_INDEX);
	}

	return 0;
}
```

## include/iso_time_sync.h
```c
/*
 * Copyright (c) 2024 Nordic Semiconductor ASA
 *
 * SPDX-License-Identifier: LicenseRef-Nordic-5-Clause
 */

#ifndef ISO_TIME_SYNC_H__
#define ISO_TIME_SYNC_H__

/** Definitions for the ISO time sync sample.
 *
 * This file contains common definitions and API declarations
 * used by the sample.
 */

#include <stdint.h>
#include <stdbool.h>
#include <zephyr/sys/printk.h>
#include <zephyr/bluetooth/iso.h>

#define SDU_SIZE_BYTES 9 /* SDU = [trigger_val(1), sdu_counter le32(4), tx_ts le32(4)]*/

/* Trigger value carried in the SDU that marks a button-initiated time-sync
 * event. Ordinary auto-generated triggers use 0/1; 2 is reserved so that the
 * transmitter and every receiver can recognize (and print) the same event.
 */
#define SYNC_EVENT_TRIGGER_VAL 2

/* Auto trigger cadence: one pulse every 5 ms (every SDU), expressed in SDUs.
 * Each SDU becomes a synchronization reference point for the logic analyzer.
 */
#define AUTO_TRIGGER_PERIOD_SDUS (5000U / CONFIG_SDU_INTERVAL_US)

/* Periodic log cadence: one log line every 1 second (200 SDUs at 5 ms),
 * shared by TX and RX so both sides print at the same cadence.
 */
#define LOG_PERIOD_SDUS (1000000U / CONFIG_SDU_INTERVAL_US)

/* Long-term stability summary cadence: one summary line every
 * CONFIG_TIME_SYNC_LT_STATS_PERIOD_S seconds, expressed in SDUs.
 */
#define LT_STATS_PERIOD_SDUS \
	((uint32_t)CONFIG_TIME_SYNC_LT_STATS_PERIOD_S * 1000000U / CONFIG_SDU_INTERVAL_US)

/** Start BIS transmitter demo.
 *
 * @param retransmission_number    Requested retransmission number.
 * @param max_transport_latency_ms Requested maximum transport latency.
 */
void bis_transmitter_start(uint8_t retransmission_number, uint16_t max_transport_latency_ms);

/** Start BIS receiver demo.
 *
 * @param bis_index_to_sync_to BIS index that it will sync to.
 */
void bis_receiver_start(uint8_t bis_index_to_sync_to);

/** Start CIS central demo.
 *
 * @param do_tx Set to true to send SDUs, otherwise it will receive.
 * @param retransmission_number    Requested retransmission number.
 * @param max_transport_latency_ms Requested maximum transport latency.
 */
void cis_central_start(bool do_tx,
		       uint8_t retransmission_number,
		       uint16_t max_transport_latency_ms);

/** Start CIS peripheral demo.
 *
 * @param do_tx Set to true to send SDUs, otherwise it will receive.
 */
void cis_peripheral_start(bool do_tx);

/** Initialize TX path channels.
 *
 * @param retransmission_number Requested retransmission number (if central or broadcaster).
 * @param iso_connected_cb Callback that is triggered when the ISO channel connects.
 *						   This can be set to NULL.
 */
void iso_tx_init(uint8_t retransmission_number, void (*iso_connected_cb)(void));

/** Request an immediate time-sync event on the transmitter.
 *
 * The next SDU is tagged with SYNC_EVENT_TRIGGER_VAL, so both the transmitter
 * and all receivers print the same SDU counter and timestamp over UART.
 */
void iso_tx_request_sync(void);

/** Initialize RX path channel.
 *
 * @param retransmission_number Requested retransmission number (if central).
 * @param Callback that is triggered when an ISO RX channel disconnects.
 *                 This can be set to NULL.
 */
void iso_rx_init(uint8_t retransmission_number, void (*iso_disconnected_cb)(void));

/** Obtain pointer to TX channels.
 *
 * @retval Pointer to the TX channels.
 */
struct bt_iso_chan **iso_tx_channels_get(void);

/** Obtain pointer to RX channels.
 *
 * @retval Pointer to the RX channels.
 */
struct bt_iso_chan **iso_rx_channels_get(void);

/** Print info ISO channel information.
 *
 * @param info ISO channel info.
 * @param role The role of the ISO channel.
 */
void iso_chan_info_print(struct bt_iso_info *info, uint8_t role);

/** Obtain the current Bluetooth controller time.
 *
 * The ISO timestamps are based upon this clock.
 *
 * @retval The current controller time.
 */
uint64_t controller_time_us_get(void);

/** Sets the controller to trigger a PPI event at the given timestamp.
 *
 * Two independent compare channels are used: one arming the "set high"
 * event and one arming the "set low" event, so that an absolute GPIO
 * level can be presented at the timestamp.
 *
 * @param timestamp_us The timestamp where it will trigger.
 * @param high_level   true to trigger the set-high event, false for set-low.
 */
void controller_time_trigger_at(uint64_t timestamp_us, bool high_level);

/** Get the address of the event that will trigger.
 *
 * @param high_level true for the set-high event, false for the set-low event.
 *
 * @retval The address of the event that will trigger.
 */
uint32_t controller_time_trigger_event_addr_get(bool high_level);

/** Initialize the module handling timed toggling of an LED.
 *
 * @retval 0 on success, failure otherwise.
 */
int timed_led_toggle_init(void);

/** Present a trigger event on the pin at the given timestamp.
 *
 * A non-zero value produces a narrow pulse (high at the timestamp, low
 * TRIGGER_PULSE_WIDTH_US later). A zero value drives the pin low
 * (idempotent idle level).
 *
 * @param value The trigger value.
 * @param timestamp_us The time when the event will be presented.
 *                     The time is specified in controller clock units.
 */
void timed_led_toggle_trigger_at(uint8_t value, uint32_t timestamp_us);

#endif
```

## include/sync_log.h
```c
/*
 * Copyright (c) 2024 Nordic Semiconductor ASA
 *
 * SPDX-License-Identifier: LicenseRef-Nordic-5-Clause
 */

#ifndef SYNC_LOG_H__
#define SYNC_LOG_H__

#include <stdint.h>
#include <stdbool.h>
#include "time_sync.h"

/**
 * @file sync_log.h
 *
 * Deferred UART logging for the ISO time sync demo.
 *
 * The periodic and event logs are formatted and printed by a dedicated
 * low-priority thread instead of the Bluetooth RX/TX workqueues. The workqueue
 * callbacks only enqueue a small fixed-size record, so console/printk latency
 * can never delay the controller-timed presentation path.
 *
 * The queue is non-blocking: if it is full the record is dropped rather than
 * stalling the caller.
 */

void sync_log_event(uint32_t counter, uint32_t timestamp_us);

void sync_log_sdu_rx(uint32_t counter, uint32_t ts, int btn_val, uint32_t shared_ts);

void sync_log_sdu_tx(uint32_t counter, uint32_t ts, uint32_t controller_time_us,
		     int btn_val, int time_to_trigger_us);

void sync_log_stats(const struct time_sync_stats *stats);

void sync_log_lt(const struct time_sync_lt_stats *lt, uint32_t received,
		 uint32_t lost, uint32_t resync);

#endif /* SYNC_LOG_H__ */
```

## include/time_sync.h
```c
/*
 * Copyright (c) 2024 Nordic Semiconductor ASA
 *
 * SPDX-License-Identifier: LicenseRef-Nordic-5-Clause
 */

#ifndef TIME_SYNC_H__
#define TIME_SYNC_H__

#include <stdint.h>
#include <stdbool.h>

/**
 * @brief Feed one reference pair into the clock servo.
 *
 * Every valid SDU provides two readings of the same physical instant:
 * the broadcaster's timestamp (carried in the SDU) and the local
 * controller timestamp (the SDU synchronization reference).
 *
 * @param tx_ts_us    Broadcaster controller timestamp (32-bit, wraps).
 * @param local_ts_us Local controller timestamp of the same instant.
 */
void time_sync_update(uint32_t tx_ts_us, uint32_t local_ts_us);

/**
 * @brief Map a local 32-bit controller timestamp onto the broadcaster's
 *        timebase.
 *
 * Both clocks wrap at the same ~1 MHz rate, so the mapping is a wrap-safe
 * unsigned 32-bit addition; do not mix in the local 64-bit GRTC high bits
 * and do not sign-extend the 32-bit value: after ~35.8 min of uptime the
 * raw controller time passes 2^31 and a signed interpretation would go
 * negative.
 *
 * @param local_ts_us Local controller timestamp (32-bit, e.g. the ISO SDU
 *        synchronization reference).
 * @return The corresponding time in the broadcaster's timebase (us,
 *         unsigned 32-bit, same modulus as the TX timestamps).
 */
uint32_t time_sync_to_shared(uint32_t local_ts_us);

/**
 * @brief Whether the servo has collected enough samples and is tracking.
 */
bool time_sync_is_locked(void);

/**
 * @brief Feed the current on-chip temperature to the servo.
 *
 * The filter scales its process noise with the temperature rate of change,
 * so it tracks faster while the crystal is warming up/cooling down and stays
 * quiet when the temperature is stable. Call it from any thread; the rate is
 * low-pass filtered internally.
 *
 * @param celsius Temperature in degrees Celsius.
 */
void time_sync_set_temperature(double celsius);

/** Servo statistics, sampled at the 10 s reporting cadence. */
struct time_sync_stats {
	bool locked;
	uint32_t samples;     /**< Accepted updates since boot. */
	uint32_t rejected;    /**< Samples rejected as outliers since boot. */
	int32_t offset_us;    /**< Estimated offset, integer part (us). */
	int32_t offset_frac;  /**< Offset hundredths of a us, 0..99. */
	int32_t drift_ppm;    /**< Estimated drift (us/s == ppm). */
	int32_t resid_max_us; /**< Worst |innovation| in the current window. */
};

/** Long-term stability summary, sampled at the LT reporting cadence. */
struct time_sync_lt_stats {
	uint32_t uptime_s;
	uint32_t samples;
	uint32_t rejected;
	bool locked;
	int32_t offset_us;
	int32_t offset_frac;
	int32_t drift_ppm;
	int32_t off_min_us;   /**< Min offset seen since the previous summary. */
	int32_t off_max_us;   /**< Max offset seen since the previous summary. */
	int32_t off_span_us;  /**< max - min, the drift/temperature excursion. */
	int32_t resid_max_us; /**< Worst |innovation| since the previous summary. */
	uint32_t window_updates;
	bool temp_valid;        /**< On-chip temperature has been sampled. */
	int32_t temp_c_x100;    /**< Temperature, hundredths of a degree C. */
	int32_t temp_rate_x1000;/**< Temperature rate, thousandths of C/s. */
};

/**
 * @brief Read the current servo statistics without changing filter state.
 */
void time_sync_stats_snapshot(struct time_sync_stats *out);

/**
 * @brief Read the long-term stability summary and start a new window.
 *
 * Safe to call from the Bluetooth RX workqueue; the reporting window is
 * reset so the next summary covers a fresh interval.
 */
void time_sync_lt_stats_snapshot(struct time_sync_lt_stats *out);

#endif /* TIME_SYNC_H__ */
```

## src/bis_receiver.c
```c
/*
 * Copyright (c) 2024 Nordic Semiconductor ASA
 *
 * SPDX-License-Identifier: LicenseRef-Nordic-5-Clause
 */

/** BIS receiver implementation for the time sync sample
 *
 * This file implements a device that syncs to a given BIS index.
 * When disconnected, it tries to sync to it again.
 */

#include <zephyr/kernel.h>
#include <zephyr/bluetooth/bluetooth.h>
#include <zephyr/bluetooth/iso.h>
#include <zephyr/device.h>
#include <zephyr/drivers/gpio.h>
#include <sdc_hci_vs.h>
#include <sdc_hci.h>
#include "iso_time_sync.h"

#define ADV_NAME_STR_MAX_LEN (sizeof(CONFIG_BT_DEVICE_NAME))

static K_SEM_DEFINE(sem_per_adv_info_valid, 0, 1);
static K_SEM_DEFINE(sem_big_info_valid, 0, 1);
static K_SEM_DEFINE(sem_per_adv_sync_lost, 0, 1);

static bool syncing_or_synced_to_periodic_adv;
static bool syncing_or_synced_to_big;

static bt_addr_le_t adv_addr;
static uint8_t adv_set_id;

static bool adv_data_parse_cb(struct bt_data *data, void *user_data)
{
	char *name = user_data;
	uint8_t len;

	switch (data->type) {
	case BT_DATA_NAME_SHORTENED:
	case BT_DATA_NAME_COMPLETE:
		len = MIN(data->data_len, ADV_NAME_STR_MAX_LEN - 1);
		memcpy(name, data->data, len);
		name[len] = '\0';
		return false;
	default:
		return true;
	}
}

static void scan_recv(const struct bt_le_scan_recv_info *info, struct net_buf_simple *buf)
{
	char name_str[ADV_NAME_STR_MAX_LEN] = {0};

	bt_data_parse(buf, adv_data_parse_cb, name_str);

	if (strncmp(name_str, CONFIG_BT_DEVICE_NAME, ADV_NAME_STR_MAX_LEN) != 0) {
		return;
	}

	if (!syncing_or_synced_to_periodic_adv) {
		bt_addr_le_copy(&adv_addr, info->addr);
		adv_set_id = info->sid;

		syncing_or_synced_to_periodic_adv = true;
		k_sem_give(&sem_per_adv_info_valid);
	}
}

static void synced_to_per_adv_cb(struct bt_le_per_adv_sync *sync,
				 struct bt_le_per_adv_sync_synced_info *info)
{
	printk("Synced to periodic advertiser\n");
}

static void sync_to_per_adv_lost_cb(struct bt_le_per_adv_sync *sync,
				    const struct bt_le_per_adv_sync_term_info *info)
{
	printk("Sync to periodic advertiser lost\n");
	k_sem_give(&sem_per_adv_sync_lost);
}

static void biginfo_rcvd_cb(struct bt_le_per_adv_sync *sync, const struct bt_iso_biginfo *biginfo)
{
	if (!syncing_or_synced_to_big) {
		printk("BigInfo received\n");
		syncing_or_synced_to_big = true;
		k_sem_give(&sem_big_info_valid);
	}
}

static struct bt_le_scan_cb scan_callbacks = {
	.recv = scan_recv,
};

static struct bt_le_per_adv_sync_cb sync_callbacks = {
	.synced = synced_to_per_adv_cb,
	.term = sync_to_per_adv_lost_cb,
	.biginfo = biginfo_rcvd_cb,
};

static void reset_state(void)
{
	k_sem_reset(&sem_per_adv_info_valid);
	k_sem_reset(&sem_big_info_valid);
	k_sem_reset(&sem_per_adv_sync_lost);
	syncing_or_synced_to_periodic_adv = false;
	syncing_or_synced_to_big = false;
}

void bis_receiver_start(uint8_t bis_index_to_sync_to)
{
	struct bt_le_per_adv_sync_param sync_create_param;
	struct bt_iso_big_sync_param big_sync_param;
	struct bt_le_per_adv_sync *sync;
	struct bt_iso_big *big;
	int err;

	uint8_t unused_rtn = 0;

	iso_rx_init(unused_rtn, NULL);

	bt_le_scan_cb_register(&scan_callbacks);
	bt_le_per_adv_sync_cb_register(&sync_callbacks);

	err = bt_le_scan_start(BT_LE_SCAN_PASSIVE_CONTINUOUS, NULL);
	if (err) {
		printk("Scan start failed (err %d)\n", err);
		return;
	}

	while (true) {
		reset_state();

		printk("Scanning for periodic advertiser\n");
		k_sem_take(&sem_per_adv_info_valid, K_FOREVER);

		syncing_or_synced_to_periodic_adv = true;

		memset(&sync_create_param, 0, sizeof(sync_create_param));
		bt_addr_le_copy(&sync_create_param.addr, &adv_addr);
		sync_create_param.options = 0;
		sync_create_param.sid = adv_set_id;
		sync_create_param.skip = 0;
		sync_create_param.timeout = 1000;

		err = bt_le_per_adv_sync_create(&sync_create_param, &sync);
		if (err) {
			printk("Sync create failed (err %d)\n", err);
			return;
		}

		printk("Waiting for BigInfo\n");
		err = k_sem_take(&sem_big_info_valid, K_MSEC(5000));
		if (err) {
			printk("Failed obtaining BigInfo in time, starting over\n");

			err = bt_le_per_adv_sync_delete(sync);
			if (err) {
				printk("Deleting periodic sync failed (err %d)\n", err);
				return;
			}

			continue;
		}

		memset(&big_sync_param, 0, sizeof(big_sync_param));
		big_sync_param.bis_channels = iso_rx_channels_get();
		big_sync_param.num_bis = 1;
		big_sync_param.bis_bitfield = BIT(bis_index_to_sync_to - 1);
		/* Request the controller to use the single best subevent. This avoids
		 * accepting an arbitrary retransmission with a less deterministic
		 * receive path during precision measurements. */
		big_sync_param.mse = 1;
		big_sync_param.sync_timeout = 100; /* in 10 ms units */

		printk("Syncing to BIG index %d\n", bis_index_to_sync_to);
		err = bt_iso_big_sync(sync, &big_sync_param, &big);
		if (err) {
			printk("Creating BIG sync failed (err %d)\n", err);
			return;
		}

		k_sem_take(&sem_per_adv_sync_lost, K_FOREVER);

		err = bt_le_per_adv_sync_delete(sync);
		if (err) {
			printk("Deleting periodic sync failed (err %d)\n", err);
			return;
		}
	}
}
```

## src/bis_transmitter.c
```c
/*
 * Copyright (c) 2024 Nordic Semiconductor ASA
 *
 * SPDX-License-Identifier: LicenseRef-Nordic-5-Clause
 */

/** BIS transmitter implementation for the time sync sample
 *
 * This file implements a device that sets up a BIS transmitter
 * with a configured number of streams.
 */

#include <zephyr/kernel.h>
#include <zephyr/bluetooth/bluetooth.h>
#include <zephyr/bluetooth/iso.h>

#include "iso_time_sync.h"

static const struct bt_data ad[] = {
	BT_DATA(BT_DATA_NAME_COMPLETE, CONFIG_BT_DEVICE_NAME, sizeof(CONFIG_BT_DEVICE_NAME) - 1),
};

void bis_transmitter_start(uint8_t retransmission_number, uint16_t max_transport_latency_ms)
{
	int err;
	struct bt_le_ext_adv *adv;
	struct bt_iso_big *big;

	iso_tx_init(retransmission_number, NULL);

	/* Create a non-connectable non-scannable advertising set */
	err = bt_le_ext_adv_create(BT_LE_EXT_ADV_NCONN, NULL, &adv);
	if (err) {
		printk("Failed to create advertising set (err %d)\n", err);
		return;
	}

	/* Set the advertising data */
	err = bt_le_ext_adv_set_data(adv, ad, ARRAY_SIZE(ad), NULL, 0);
	if (err) {
		printk("failed to set advertising data (err %d)\n", err);
		return;
	}

	/* Set periodic advertising parameters */
	err = bt_le_per_adv_set_param(adv, BT_LE_PER_ADV_PARAM(BT_GAP_PER_ADV_FAST_INT_MIN_2,
							       BT_GAP_PER_ADV_FAST_INT_MAX_2,
							       BT_LE_PER_ADV_OPT_NONE));
	if (err) {
		printk("Failed to set periodic advertising parameters"
		       " (err %d)\n",
		       err);
		return;
	}

	/* Start extended advertising */
	err = bt_le_ext_adv_start(adv, BT_LE_EXT_ADV_START_DEFAULT);
	if (err) {
		printk("Failed to start extended advertising (err %d)\n", err);
		return;
	}

	/* Enable Periodic Advertising */
	err = bt_le_per_adv_start(adv);
	if (err) {
		printk("Failed to enable periodic advertising (err %d)\n", err);
		return;
	}

	struct bt_iso_big_create_param big_create_param = {
		/* Only one BIS is needed: all receivers sync to BIS index 1.
		 * The SoftDevice Controller reserves 2.5 ms for periodic
		 * advertising, so at the minimum 5 ms ISO interval a single BIS
		 * (NSE=2) is what fits - 8 BIS would exceed the BIG event budget.
		 */
		.num_bis = 1,
		.bis_channels = iso_tx_channels_get(),
		.interval = CONFIG_SDU_INTERVAL_US,
		.latency = max_transport_latency_ms,
		.packing = 0, /* 0 - sequential, 1 - interleaved */
		.framing = 0, /* 0 - unframed, 1 - framed */
	};

	/* Create BIG */
	err = bt_iso_big_create(adv, &big_create_param, &big);
	if (err) {
		printk("Failed to create BIG (err %d)\n", err);
		return;
	}

	printk("BIS transmitter started\n");
}
```

## src/controller_time_nrf54.c
```c
/*
 * Copyright (c) 2024 Nordic Semiconductor ASA
 *
 * SPDX-License-Identifier: LicenseRef-Nordic-5-Clause
 */

/** This file implements controller time management for 54 Series devices
 *
 * Two GRTC compare channels are allocated: one generates the "set high"
 * event and one generates the "set low" event. This allows presenting an
 * absolute GPIO level at a controller-timed timestamp via DPPI/GPIOTE,
 * which is robust against lost SDUs (idempotent, self-correcting).
 */

#include <zephyr/kernel.h>
#include <nrfx_grtc.h>
#include "iso_time_sync.h"

static uint8_t grtc_channel_set;
static uint8_t grtc_channel_clr;

int controller_time_init(void)
{
	int ret;

	ret = nrfx_grtc_channel_alloc(&grtc_channel_set);
	if (ret < 0) {
		printk("Failed allocating GRTC set channel (ret: %d)\n", ret);
		return ret;
	}

	ret = nrfx_grtc_channel_alloc(&grtc_channel_clr);
	if (ret < 0) {
		printk("Failed allocating GRTC clr channel (ret: %d)\n", ret);
		return ret;
	}

	nrf_grtc_sys_counter_compare_event_enable(NRF_GRTC, grtc_channel_set);
	nrf_grtc_sys_counter_compare_event_enable(NRF_GRTC, grtc_channel_clr);

	return 0;
}

uint64_t controller_time_us_get(void)
{
	return nrfx_grtc_syscounter_get();
}

void controller_time_trigger_at(uint64_t timestamp_us, bool high_level)
{
	int ret;

	nrfx_grtc_channel_t chan_data = {
		.channel = high_level ? grtc_channel_set : grtc_channel_clr,
	};

	ret = nrfx_grtc_syscounter_cc_absolute_set(&chan_data, timestamp_us, false);
	if (ret != 0) {
		printk("Failed setting CC (ret: %d)\n", ret);
	}
}

uint32_t controller_time_trigger_event_addr_get(bool high_level)
{
	return nrf_grtc_event_address_get(NRF_GRTC,
					  nrf_grtc_sys_counter_compare_event_get(high_level ?
										 grtc_channel_set :
										 grtc_channel_clr));
}

SYS_INIT(controller_time_init, POST_KERNEL, CONFIG_KERNEL_INIT_PRIORITY_DEFAULT);
```

## src/iso_rx.c
```c
/*
 * Copyright (c) 2024 Nordic Semiconductor ASA
 *
 * SPDX-License-Identifier: LicenseRef-Nordic-5-Clause
 */

/** This file implements receiving SDUs for the time sync demo
 *
 * When a valid SDU is received two things are done:
 *  1. A LED is toggled immediately
 *  2. A timer trigger is configured to toggle another LED
 *     CONFIG_TIMED_LED_PRESENTATION_DELAY_US after the received timestamp.
 *     This will ensure that all receivers toggle it at the same time.
 */

#include <zephyr/kernel.h>
#include <zephyr/bluetooth/iso.h>
#include <zephyr/device.h>
#include <zephyr/drivers/gpio.h>
#include "iso_time_sync.h"
#include "time_sync.h"
#include "sync_log.h"

static void iso_recv(struct bt_iso_chan *chan, const struct bt_iso_recv_info *info,
		     struct net_buf *buf);
static void iso_connected(struct bt_iso_chan *chan);
static void iso_disconnected(struct bt_iso_chan *chan, uint8_t reason);

static void (*iso_chan_disconnected_cb)(void);

static struct gpio_dt_spec led_sdu_received = GPIO_DT_SPEC_GET_OR(DT_ALIAS(led0), gpios, {0});

static struct bt_iso_chan_ops iso_ops = {
	.recv = iso_recv,
	.connected = iso_connected,
	.disconnected = iso_disconnected,
};

static struct bt_iso_chan_io_qos iso_rx_qos = {
	.sdu = SDU_SIZE_BYTES,
	.phy = BT_GAP_LE_PHY_2M,
};

static struct bt_iso_chan_qos iso_qos = {
	.rx = &iso_rx_qos,
};

static struct bt_iso_chan iso_chan[] = {
	{
		.ops = &iso_ops,
		.qos = &iso_qos,
	},
};

static struct bt_iso_chan *iso_channels[] = {
	&iso_chan[0],
};

/* Long-term link statistics for stability verification: received SDUs,
 * estimated missing SDUs (counter gaps), and large-gap re-sync events.
 * A gap of RX_RESYNC_GAP_SDUS or more is treated as a lost/re-synced BIG.
 */
#define RX_RESYNC_GAP_SDUS 200 /* >= 1 s at the 5 ms SDU interval */
static uint32_t rx_sdu_count;
static uint32_t rx_lost_count;
static uint32_t rx_resync_count;
static uint32_t rx_prev_counter;
static bool rx_have_prev;

static void iso_recv(struct bt_iso_chan *chan, const struct bt_iso_recv_info *info,
		     struct net_buf *buf)
{
	if ((info->flags & BT_ISO_FLAGS_VALID) == 0) {
		/* The packet should be valid. */
		return;
	}

	if ((info->flags & BT_ISO_FLAGS_TS) == 0) {
		/* The packet should contain a timestamp */
		return;
	}

	if (buf->len != SDU_SIZE_BYTES) {
		return;
	}

	/* NOTE: net_buf_remove_*() consumes bytes from the END of the buffer
	 * (net_buf_pull_*() consumes from the beginning). The SDU is
	 * [trigger_val(1), sdu_counter(4), tx_ts(4)], so the tx_ts must be
	 * removed first, then the counter, then the trigger byte. Do not
	 * reorder these lines without checking the buffer-end semantics of
	 * net_buf_remove_*().
	 */
	uint32_t tx_ts = net_buf_remove_le32(buf);
	uint32_t counter = net_buf_remove_le32(buf);
	uint8_t btn_pressed = net_buf_remove_u8(buf);

	/* Link statistics: the broadcaster increments the counter by one per
	 * SDU, so a gap means SDUs were missed. Unsigned subtraction stays
	 * correct across the 32-bit wrap.
	 */
	rx_sdu_count++;
	if (rx_have_prev) {
		uint32_t gap = counter - rx_prev_counter;

		if (gap > 1) {
			rx_lost_count += gap - 1;
			if (gap >= RX_RESYNC_GAP_SDUS) {
				rx_resync_count++;
			}
		}
	}
	rx_prev_counter = counter;
	rx_have_prev = true;

	if (IS_ENABLED(CONFIG_LED_TOGGLE_IMMEDIATELY_ON_SEND_OR_RECEIVE)) {
		gpio_pin_set_dt(&led_sdu_received, btn_pressed);
	}
	uint32_t trigger_time_us = info->ts + CONFIG_TIMED_LED_PRESENTATION_DELAY_US;

	timed_led_toggle_trigger_at(btn_pressed, trigger_time_us);

	/* Feed the reference pair into the clock servo. The first SDU
	 * (counter 0) carries no valid TX timestamp (tx_ts == 0): skip it.
	 */
	if (counter != 0 && tx_ts != 0) {
		time_sync_update(tx_ts, info->ts);
	}

	if (btn_pressed == SYNC_EVENT_TRIGGER_VAL) {
		/* Colour-highlighted sync log (UART): RX-side timestamp mapped
		 * into the broadcaster timebase, matching the TX-side timestamp.
		 */
		sync_log_event(counter, time_sync_to_shared(info->ts));
	}

	if (counter % LOG_PERIOD_SDUS == 0) {
		sync_log_sdu_rx(counter, info->ts, btn_pressed,
				time_sync_to_shared(info->ts));
	}

	if (counter != 0 && counter % 2000 == 0) {
		struct time_sync_stats stats;

		time_sync_stats_snapshot(&stats);
		sync_log_stats(&stats);
	}

	if (counter != 0 && counter % LT_STATS_PERIOD_SDUS == 0) {
		struct time_sync_lt_stats lt;

		time_sync_lt_stats_snapshot(&lt);
		sync_log_lt(&lt, rx_sdu_count, rx_lost_count, rx_resync_count);
	}
}

static void iso_connected(struct bt_iso_chan *chan)
{
	const struct bt_iso_chan_path hci_path = {
		.pid = BT_ISO_DATA_PATH_HCI,
		.format = BT_HCI_CODING_FORMAT_TRANSPARENT,
	};

	int err;
	struct bt_conn_info conn_info;
	struct bt_iso_info iso_info;

	err = bt_iso_chan_get_info(chan, &iso_info);
	if (err) {
		printk("Failed obtaining ISO info\n");
		return;
	}

	err = bt_conn_get_info(chan->iso, &conn_info);
	if (err) {
		printk("Failed obtaining conn info\n");
		return;
	}

	printk("ISO Channel connected: ");
	iso_chan_info_print(&iso_info, conn_info.role);

	err = bt_iso_setup_data_path(chan, BT_HCI_DATAPATH_DIR_CTLR_TO_HOST, &hci_path);
	if (err != 0) {
		printk("Failed to setup ISO RX data path: %d\n", err);
	}
}

static void iso_disconnected(struct bt_iso_chan *chan, uint8_t reason)
{
	printk("ISO Channel disconnected with reason 0x%02x\n", reason);

	if (iso_chan_disconnected_cb) {
		iso_chan_disconnected_cb();
	}
}

void iso_rx_init(uint8_t retransmission_number, void (*iso_disconnected_cb)(void))
{
	int err;

	iso_chan_disconnected_cb = iso_disconnected_cb;

	iso_rx_qos.rtn = retransmission_number;

	if (IS_ENABLED(CONFIG_LED_TOGGLE_IMMEDIATELY_ON_SEND_OR_RECEIVE)) {
		err = gpio_pin_configure_dt(&led_sdu_received, GPIO_OUTPUT_INACTIVE);
		if (err != 0) {
			printk("Error %d: failed to configure LED device %s pin %d\n", err,
				led_sdu_received.port->name, led_sdu_received.pin);
		}
	}

}

struct bt_iso_chan **iso_rx_channels_get(void)
{
	return iso_channels;
}
```

## src/iso_tx.c
```c
/*
 * Copyright (c) 2024 Nordic Semiconductor ASA
 *
 * SPDX-License-Identifier: LicenseRef-Nordic-5-Clause
 */

/** This file implements transmitting SDUs for the time sync demo
 *
 * Each SDU contains a counter and the current value of a button.
 * The implementation ensures the following:
 *
 * 1. The SDU is transmitted right before it is supposed to be
 *    sent on air.
 * 2. The SDU is transmitted on all the connected isochronous channels
 *    with the same timestamp. This ensures that all the receivers
 *    can toggle their corresponding LEDs at the same time.
 * 3. A LED is toggled when the data is sent. This can be used
 *    to observe the end-to-end latency.s
 * 4. A LED is toggled when the LED is supposed to be toggled on the
 *    receiving side.
 */

#include <zephyr/kernel.h>
#include <zephyr/device.h>
#include <zephyr/drivers/gpio.h>
#include <zephyr/bluetooth/iso.h>
#include <bluetooth/hci_vs_sdc.h>
#include <sdc_hci.h>

#include "iso_time_sync.h"
#include "sync_log.h"

static struct gpio_dt_spec led_on_sdu_send = GPIO_DT_SPEC_GET_OR(DT_ALIAS(led0), gpios, {0});

/* Auto trigger source: one pulse event every 100 ms, derived from the SDU
 * counter (see AUTO_TRIGGER_PERIOD_SDUS). The pulse itself is generated on
 * the GPIO at the presentation instant (see timed_led_toggle.c). To use an
 * external trigger signal instead, sample its GPIO here.
 */
static bool trigger_value_get(uint32_t sdu_counter)
{
	return (sdu_counter % AUTO_TRIGGER_PERIOD_SDUS) == 0;
}

static void iso_sent(struct bt_iso_chan *chan);
static void iso_connected(struct bt_iso_chan *chan);
static void iso_disconnected(struct bt_iso_chan *chan, uint8_t reason);

static void (*iso_chan_connected_cb)(void);

NET_BUF_POOL_FIXED_DEFINE(tx_pool, CONFIG_BT_ISO_MAX_CHAN,
			  BT_ISO_SDU_BUF_SIZE(CONFIG_BT_ISO_TX_MTU),
			  CONFIG_BT_CONN_TX_USER_DATA_SIZE, NULL);

static bool first_sdu_sent;
static uint32_t tx_sdu_timestamp_us;
static uint32_t num_sdus_sent;

/* Button-initiated time-sync event state. */
static volatile bool sync_event_requested;
static bool sync_event_in_flight;
static uint32_t sync_event_counter;

static void sdu_work_handler(struct k_work *work);
static K_WORK_DELAYABLE_DEFINE(sdu_work, sdu_work_handler);

static struct bt_iso_chan_ops iso_ops = {
	.connected = iso_connected,
	.sent = iso_sent,
	.disconnected = iso_disconnected,
};

static struct bt_iso_chan_io_qos iso_tx_qos = {
	.sdu = SDU_SIZE_BYTES,
	.phy = BT_GAP_LE_PHY_2M,
};

static struct bt_iso_chan_qos iso_qos = {
	.tx = &iso_tx_qos,
};

/* Create lists of ISO channels and pointers to ISO channels. */
#define _ISO_CHANNEL(_n, _)  {.ops = &iso_ops, .qos = &iso_qos}
static struct bt_iso_chan iso_channels[] = {
	LISTIFY(CONFIG_BT_ISO_MAX_CHAN, _ISO_CHANNEL, (,))
};

#define _ISO_CHANNEL_PTR(_n, _) &iso_channels[_n]
static struct bt_iso_chan *iso_channel_pointers[] = {
	LISTIFY(CONFIG_BT_ISO_MAX_CHAN, _ISO_CHANNEL_PTR, (,))
};

static bool iso_channels_awaiting_iso_sent_cb[CONFIG_BT_ISO_MAX_CHAN];

/* Store info about the ISO channels in use. */
static uint8_t roles[CONFIG_BT_ISO_MAX_CHAN];
static struct bt_iso_info iso_infos[CONFIG_BT_ISO_MAX_CHAN];

void iso_chan_info_print(struct bt_iso_info *info, uint8_t role)
{
	if (info->type == BT_ISO_CHAN_TYPE_CENTRAL || info->type == BT_ISO_CHAN_TYPE_PERIPHERAL) {
		uint8_t bn;
		uint32_t flush_timeout;
		uint32_t transport_latency_us;

		if (role == BT_CONN_ROLE_CENTRAL) {
			bn = info->can_send ?
				info->unicast.central.bn :
				info->unicast.peripheral.bn;
			flush_timeout = info->can_send ?
				info->unicast.central.flush_timeout :
				info->unicast.peripheral.flush_timeout;
			transport_latency_us = info->can_send ?
				info->unicast.central.latency :
				info->unicast.peripheral.latency;
		} else {
			bn = info->can_send ?
				info->unicast.peripheral.bn :
				info->unicast.central.bn;
			flush_timeout = info->can_send ?
				info->unicast.peripheral.flush_timeout :
				info->unicast.central.flush_timeout;
			transport_latency_us = info->can_send ?
				info->unicast.peripheral.latency :
				info->unicast.central.latency;
		}

		printk("interval: %d ms, NSE: %d, BN: %d, FT: %d, transport latency: %d us\n",
				info->iso_interval * 1250 / 1000,
				info->max_subevent,
				bn,
				flush_timeout / info->iso_interval,
				transport_latency_us);
	} else if (info->type == BT_ISO_CHAN_TYPE_BROADCASTER) {
		printk("interval: %d ms, NSE: %d, BN: %d, IRC: %d, PTO: %d, transport latency: %d us\n",
				info->iso_interval * 1250 / 1000,
				info->max_subevent,
				info->broadcaster.bn,
				info->broadcaster.irc,
				info->broadcaster.pto / info->iso_interval,
				info->broadcaster.latency);
	} else if (info->type == BT_ISO_CHAN_TYPE_SYNC_RECEIVER) {
		printk("interval: %d ms, NSE: %d, BN: %d, IRC: %d, PTO: %d, transport latency: %d us\n",
				info->iso_interval * 1250 / 1000,
				info->max_subevent,
				info->sync_receiver.bn,
				info->sync_receiver.irc,
				info->sync_receiver.pto / info->iso_interval,
				info->sync_receiver.latency);
	} else {
		printk("Unknown ISO channel type %d\n", info->type);
	}
}

static int iso_tx_time_stamp_get(struct bt_conn *conn, uint32_t *time_stamp)
{
	int err;
	uint16_t conn_handle = 0;
	sdc_hci_cmd_vs_iso_read_tx_timestamp_t params;
	sdc_hci_cmd_vs_iso_read_tx_timestamp_return_t rsp;

	err = bt_hci_get_conn_handle(conn, &conn_handle);
	if (err) {
		printk("Failed to get conn_handle %d\n", err);
		return err;
	}

	params.conn_handle = conn_handle;

	err = hci_vs_sdc_iso_read_tx_timestamp(&params, &rsp);
	if (err) {
		return err;
	}

	*time_stamp = rsp.tx_time_stamp;

	return 0;
}

static int send_next_sdu(struct bt_iso_chan *chan, uint8_t trigger_val)
{
	struct net_buf *buf;

	buf = net_buf_alloc(&tx_pool, K_FOREVER);
	if (!buf) {
		printk("Data buffer allocate timeout\n");
		return -ENOMEM;
	}

	net_buf_reserve(buf, BT_ISO_CHAN_SEND_RESERVE);
	net_buf_add_u8(buf, trigger_val);
	net_buf_add_le32(buf, num_sdus_sent);
	/* Embed the scheduled transmission timestamp of this SDU. It is the
	 * controller clock instant corresponding to the SDU synchronization
	 * reference; for the first SDU (counter 0) it is not yet known and
	 * stays 0 - the receiver skips that sample.
	 */
	net_buf_add_le32(buf, tx_sdu_timestamp_us);

	if (first_sdu_sent) {
		return bt_iso_chan_send_ts(chan, buf, 0, tx_sdu_timestamp_us);
	} else {
		return bt_iso_chan_send(chan, buf, 0);
	}

	return 0;
}

void iso_tx_request_sync(void)
{
	sync_event_requested = true;
}

static void send_next_sdu_on_all_channels(void)
{
	int err;
	uint8_t trigger_val;

	if (sync_event_requested) {
		/* Tag this SDU as a button-initiated sync event so that the
		 * transmitter and every receiver can print the same counter and
		 * timestamp.
		 */
		sync_event_requested = false;
		sync_event_in_flight = true;
		sync_event_counter = num_sdus_sent;
		trigger_val = SYNC_EVENT_TRIGGER_VAL;
	} else {
		trigger_val = trigger_value_get(num_sdus_sent) ? 1 : 0;
	}

	if (IS_ENABLED(CONFIG_LED_TOGGLE_IMMEDIATELY_ON_SEND_OR_RECEIVE)) {
		gpio_pin_set_dt(&led_on_sdu_send, trigger_val != 0);
	}

	for (size_t i = 0; i < CONFIG_BT_ISO_MAX_CHAN; i++) {

		if (iso_channels[i].state != BT_ISO_STATE_CONNECTED) {
			continue;
		}

		err = send_next_sdu(&iso_channels[i], trigger_val);
		if (err) {
			printk("Failed sending SDU, counter %d, index %d\n", num_sdus_sent, i);
			return;
		}

		/* Toggle that we are awaiting iso_sent callback on this channel */
		iso_channels_awaiting_iso_sent_cb[i] = true;

		if (!first_sdu_sent) {
			/* The first time we send an SDU, we send it without timestamp.
			 * After that we always send SDUs with timestamps to ensure they
			 * are time synchronized on all channels.
			 *
			 * To avoid reading the timestamp both after sending SDUs and after
			 * the first SDU, we break out early here the very first event.
			 */
			first_sdu_sent = true;
			break;
		}
	}
}

static void iso_connected(struct bt_iso_chan *chan)
{
	const struct bt_iso_chan_path hci_path = {
		.pid = BT_ISO_DATA_PATH_HCI,
		.format = BT_HCI_CODING_FORMAT_TRANSPARENT,
	};

	int err;
	struct bt_conn_info conn_info;
	uint8_t chan_index = ARRAY_INDEX(iso_channels, chan);

	err = bt_iso_chan_get_info(chan, &iso_infos[chan_index]);
	if (err) {
		printk("Failed obtaining ISO info\n");
		return;
	}

	err = bt_conn_get_info(chan->iso, &conn_info);
	if (err) {
		printk("Failed obtaining conn info\n");
		return;
	}

	roles[chan_index] = conn_info.role;

	printk("ISO channel index %d connected: ", chan_index);
	iso_chan_info_print(&iso_infos[chan_index], roles[chan_index]);

	err = bt_iso_setup_data_path(chan, BT_HCI_DATAPATH_DIR_HOST_TO_CTLR, &hci_path);
	if (err != 0) {
		printk("Failed to setup ISO TX data path: %d\n", err);
	}

	if (iso_chan_connected_cb) {
		iso_chan_connected_cb();
	}

	if (!first_sdu_sent) {
		/* Send the first SDU immediately.
		 * The following SDUs will be sent time-aligned with the controller clock.
		 */
		send_next_sdu_on_all_channels();
	}
}

static void iso_disconnected(struct bt_iso_chan *chan, uint8_t reason)
{
	uint32_t chan_index = ARRAY_INDEX(iso_channels, chan);

	printk("ISO Channel index %d disconnected with reason 0x%02x\n",
	       chan_index, reason);

	iso_channels_awaiting_iso_sent_cb[chan_index] = false;
}

static bool send_more_sdus_with_same_timestamp(struct bt_iso_chan *chan)
{
	if (first_sdu_sent) {
		struct bt_iso_chan *last_chan = NULL;

		/** Check if this is the last ISO channel where we are awaiting
		 * an iso_sent callback. If that is the case, that callback will
		 * be used to send SDUs on all ISO channels.
		 */
		for (size_t i = 0; i < CONFIG_BT_ISO_MAX_CHAN; i++) {
			if (iso_channels_awaiting_iso_sent_cb[i]) {
				last_chan = &iso_channels[i];
			}
		}

		if (chan != last_chan) {
			return true;
		} else {
			return false;
		}
	}

	return false;
}

static uint32_t trigger_time_us_get(uint32_t sdu_sync_ref, uint8_t chan_index)
{
	uint32_t trigger_time_us = sdu_sync_ref + CONFIG_TIMED_LED_PRESENTATION_DELAY_US;

	/* The ISO type determines when to trigger the LED
	 * because of how the SDU synchronization reference is defined.
	 * See Bluetooth Core Specification, Vol 6, Part G, Section 3.2.
	 */

	if (iso_infos[chan_index].type == BT_ISO_CHAN_TYPE_CENTRAL ||
	    iso_infos[chan_index].type == BT_ISO_CHAN_TYPE_PERIPHERAL) {
		if (roles[chan_index] == BT_CONN_ROLE_CENTRAL) {
			trigger_time_us += iso_infos[chan_index].unicast.central.latency;
		}
	} else {
		trigger_time_us += iso_infos[chan_index].broadcaster.latency;
	}

	return trigger_time_us;
}

static void iso_sent(struct bt_iso_chan *chan)
{
	int err;
	uint32_t assigned_timestamp;

	if (send_more_sdus_with_same_timestamp(chan)) {
		return;
	}

	err = iso_tx_time_stamp_get(chan->iso, &assigned_timestamp);
	if (err) {
		printk("Failed obtaining timestamp\n");
		return;
	}

	uint8_t chan_index = ARRAY_INDEX(iso_channels, chan);

	/* Present the trigger value of the SDU just sent (num_sdus_sent is
	 * incremented below, so it still holds the counter of this SDU). A
	 * button-initiated sync event is non-zero, so it also produces a pulse
	 * on P1.10; otherwise the 100 ms auto trigger applies.
	 */
	bool btn_pressed;

	if (sync_event_in_flight && num_sdus_sent == sync_event_counter) {
		btn_pressed = true;
	} else {
		btn_pressed = trigger_value_get(num_sdus_sent);
	}
	uint32_t trigger_time_us = trigger_time_us_get(assigned_timestamp,
						       chan_index);
	timed_led_toggle_trigger_at(btn_pressed, trigger_time_us);

	/* Set up a timer to trigger right before the next set of SDUs are to be sent. */
	uint32_t controller_time_us = controller_time_us_get() & UINT32_MAX;
	int32_t time_to_next_sdu_us =
		assigned_timestamp + CONFIG_SDU_INTERVAL_US
		- controller_time_us
		- HCI_ISO_TX_SDU_ARRIVAL_MARGIN_US;

#ifdef NRF53_SERIES
	/* Account for some delay to forward the data between the cores. */
	time_to_next_sdu_us -= 1000;
#endif

	/** Update the sent SDU counter before starting
	 * the timer that triggers when the next SDU is sent.
	 * This is done to ensure that counter is updated in time.
	 */
	uint32_t prev_sent_sdu = num_sdus_sent;

	num_sdus_sent++;

	iso_channels_awaiting_iso_sent_cb[chan_index] = false;

	k_work_schedule(&sdu_work, K_USEC(time_to_next_sdu_us));

	/* Increment the SDU timestamp with one SDU interval. */
	tx_sdu_timestamp_us = assigned_timestamp + CONFIG_SDU_INTERVAL_US;

	if (sync_event_in_flight && prev_sent_sdu == sync_event_counter) {
		/* Colour-highlighted sync log (UART): TX-side timestamp of the
		 * button-initiated sync event, in the broadcaster timebase.
		 */
		sync_log_event(prev_sent_sdu, assigned_timestamp);
		sync_event_in_flight = false;
	}

	if (prev_sent_sdu % LOG_PERIOD_SDUS == 0) {
		int32_t time_to_trigger = trigger_time_us - controller_time_us;

		sync_log_sdu_tx(prev_sent_sdu, assigned_timestamp, controller_time_us,
				btn_pressed, time_to_trigger);
	}
}

static void sdu_work_handler(struct k_work *work)
{
	ARG_UNUSED(work);
	send_next_sdu_on_all_channels();
}

void iso_tx_init(uint8_t retransmission_number, void (*iso_connected_cb)(void))
{
	int err;
	iso_chan_connected_cb = iso_connected_cb;

	iso_tx_qos.rtn = retransmission_number;

	if (IS_ENABLED(CONFIG_LED_TOGGLE_IMMEDIATELY_ON_SEND_OR_RECEIVE)) {
		err = gpio_pin_configure_dt(&led_on_sdu_send, GPIO_OUTPUT_INACTIVE);
		if (err != 0) {
			printk("Error %d: failed to configure LED device %s pin %d\n", err,
				led_on_sdu_send.port->name, led_on_sdu_send.pin);
		}
	}
}

struct bt_iso_chan **iso_tx_channels_get(void)
{
	return iso_channel_pointers;
}
```
